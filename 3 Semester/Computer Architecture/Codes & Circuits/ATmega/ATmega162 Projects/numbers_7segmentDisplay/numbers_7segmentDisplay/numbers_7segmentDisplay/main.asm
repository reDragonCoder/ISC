;
; numbers_7segmentDisplay.asm
;
; Created: 27/10/2024 12:31:35 a. m.
; Author : reDragonCoder
;

.INCLUDE <M162DEF.INC>

; STACK POINTER CONFIGURATION
	LDI R16, 0X04
	OUT SPH, R16	; THIS IS THE UPPER PART OF THE SP REGISTER
	LDI R16, 0XFF
	OUT SPL, R16	; THIS IS THE LOWER PART OF THE SP REGISTER

; WE DECLARE THE POINTER "A" AS OUTPUT
	LDI R16, 0XFF
	OUT DDRA, R16	; WE CONFIGURE THE PORT AS OUTPUT

; WE DEFINE THE DATA (NUMBERS) FOR THE REGISTERS
CYCLE1:
	LDI R17, 0x3F ; 0
	LDI R18, 0x6  ; 1
	LDI R19, 0x5B ; 2
	LDI R20, 0x4F ; 3
	LDI R21, 0x66 ; 4
	LDI R22, 0x6D ; 5
	LDI R23, 0x7D ; 6
	LDI R24, 0x7  ; 7
	LDI R25, 0x7F ; 8
	LDI R26, 0x6F ; 9

	OUT PORTA, R17
	RCALL SUBROUTINE
	OUT PORTA, R18
	RCALL SUBROUTINE
	OUT PORTA, R19
	RCALL SUBROUTINE
	OUT PORTA, R20
	RCALL SUBROUTINE
	OUT PORTA, R21
	RCALL SUBROUTINE
	OUT PORTA, R22
	RCALL SUBROUTINE
	OUT PORTA, R23
	RCALL SUBROUTINE
	OUT PORTA, R24
	RCALL SUBROUTINE
	OUT PORTA, R25
	RCALL SUBROUTINE
	OUT PORTA, R26
	RCALL SUBROUTINE
	RJMP CYCLE1

SUBROUTINE:	
			LDI R29, 8
			LDI R30, 150
			LDI R31, 128
			
L1:			
			DEC R31
			BRNE L1
			DEC R30
			BRNE L1
			DEC R29
			BRNE L1

			RET



			