;
; cascade_LEDs.asm
; ATMEGA162
; Created: 21/10/2024 09:19:08 p. m.
; Author : reDragonCoder
;

.INCLUDE <M162DEF.INC>

; STACK POINTER CONFIGURATION
	LDI R16, 0X04
	OUT SPH, R16	; THIS IS THE UPPER PART OF THE SP REGISTER
	LDI R16, 0XFF
	OUT SPL, R16	; THIS IS THE LOWER PART OF THE SP REGISTER

; WE DECLARE THE POINTER "A" AS OUTPUT
	LDI R16, 0XFF
	OUT DDRA, R16	; WE CONFIGURE THE PORT AS OUTPUT

; WE DEFINE THE DATA FOR THE REGISTERS
	LDI R17, 0B10000000
	LDI R18, 0B01000000
	LDI R19, 0B00100000
	LDI R20, 0B00010000
	LDI R21, 0B00001000
	LDI R22, 0B00000100
	LDI R23, 0B00000010
	LDI R24, 0B00000001

CYCLE:	OUT PORTA, R17
		RCALL SUBROUTINE
		OUT PORTA, R18
		RCALL SUBROUTINE
		OUT PORTA, R19
		RCALL SUBROUTINE
		OUT PORTA, R20
		RCALL SUBROUTINE
		OUT PORTA, R21
		RCALL SUBROUTINE
		OUT PORTA, R22
		RCALL SUBROUTINE
		OUT PORTA, R23
		RCALL SUBROUTINE
		OUT PORTA, R24
		RCALL SUBROUTINE
		OUT PORTA, R23
		RCALL SUBROUTINE
		OUT PORTA, R22
		RCALL SUBROUTINE
		OUT PORTA, R21
		RCALL SUBROUTINE
		OUT PORTA, R20
		RCALL SUBROUTINE
		OUT PORTA, R19
		RCALL SUBROUTINE
		OUT PORTA, R18
		RCALL SUBROUTINE
		RJMP CYCLE

SUBROUTINE:	
			LDI R25, 8
			LDI R26, 150
			LDI R27, 128
			
L1:			
			DEC R27
			BRNE L1
			DEC R26
			BRNE L1
			DEC R25
			BRNE L1

			RET
			

